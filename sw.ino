#include <Wire.h>
#include <Adafruit_GFX.h>
#include <Adafruit_SSD1306.h>

#define SCREEN_WIDTH 128
#define SCREEN_HEIGHT 64
#define BUTTON_PIN 7
#include <Servo.h>
bool displayFirstImage = true;
Adafruit_SSD1306 display(SCREEN_WIDTH, SCREEN_HEIGHT, &Wire, -1);
const char button = 7; 
int servo = 9;
int goc;
Servo myServo;
static const unsigned char PROGMEM image_data_2array[] = { 
  // ARRAY for DISTRESSED_EYES
  0x00, 0x00, 0x00, 0x00, 0x00, 0x00, 0x00, 0x00, 0x00, 0x00, 0x00, 0x00, 0x00, 0x00, 0x00, 0x00, 
  0x00, 0x00, 0x00, 0x00, 0x00, 0x00, 0x00, 0x00, 0x00, 0x00, 0x00, 0x00, 0x00, 0x00, 0x00, 0x00, 
  0x00, 0x00, 0x00, 0x00, 0x00, 0x00, 0x00, 0x00, 0x00, 0x00, 0x00, 0x00, 0x00, 0x00, 0x00, 0x00, 
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  0x00, 0x00, 0x00, 0x00, 0x00, 0x00, 0x00, 0x00, 0x00, 0x00, 0x00, 0x00, 0x00, 0x00, 0x00, 0x00,   
};

static const unsigned char PROGMEM image_data_3array[] = { 
  // ARRAY for 2nd Array EYES_FRONT 
  0x00, 0x00, 0x00, 0x00, 0x00, 0x00, 0x00, 0x00, 0x00, 0x00, 0x00, 0x00, 0x00, 0x00, 0x00, 0x00, 
  0x00, 0x00, 0x00, 0x00, 0x00, 0x00, 0x00, 0x00, 0x00, 0x00, 0x00, 0x00, 0x00, 0x00, 0x00, 0x00, 
  0x00, 0x00, 0x00, 0x00, 0x00, 0x00, 0x00, 0x00, 0x00, 0x00, 0x00, 0x00, 0x00, 0x00, 0x00, 0x00, 
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  0x00, 0x00, 0x00, 0x00, 0x00, 0x00, 0x00, 0x00, 0x00, 0x00, 0x00, 0x00, 0x00, 0x00, 0x00, 0x00, 
};

static const unsigned char PROGMEM image_data_openarray[] = { 
  // ARRAY for 3nd Array EYES_RIGHT
 0x00, 0x00, 0x00, 0x00, 0x00, 0x00, 0x00, 0x00, 0x00, 0x00, 0x00, 0x00, 0x00, 0x00, 0x00, 0x00, 
	0x00, 0x00, 0x00, 0x00, 0x00, 0x00, 0x00, 0x00, 0x00, 0x00, 0x00, 0x00, 0x00, 0x00, 0x00, 0x00, 
	0x00, 0x00, 0x00, 0x00, 0x00, 0x00, 0x00, 0x00, 0x00, 0x00, 0x00, 0x00, 0x00, 0x00, 0x00, 0x00, 
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	0x00, 0x00, 0x00, 0x00, 0x00, 0x00, 0x00, 0x00, 0x00, 0x00, 0x00, 0x00, 0x00, 0x00, 0x00, 0x00
};

void setup() {
  Serial.begin(9600);
   if(!display.begin(SSD1306_SWITCHCAPVCC, 0x3C)) {
    Serial.println(F("SSD1306 allocation failed"));
    for(;;);
}
  myServo.attach(servo); 
  pinMode(BUTTON_PIN, INPUT_PULLUP);
  delay(50); // Pause for 2 seconds

  display.clearDisplay();  // Clear the buffer
display.drawBitmap(0, 0, image_data_openarray, 128, 64, 1);
  display.display();
  delay(500);
  display.drawBitmap(0, 0, image_data_2array, 128, 64, 1);
  display.display();
   delay(500);
  display.drawBitmap(0, 0, image_data_3array, 128, 64, 1);
  display.display();
   delay(800);
// Displays DISTRESSED_EYES on the screen
}

void loop() {

 

if (digitalRead(BUTTON_PIN) == LOW) {
   unsigned long startTime = millis();
  unsigned long switchTime = 100; 
    // Button is pressed, display the bitmaps continuously
    while (millis() - startTime < switchTime) { // Display for 15 seconds
      display.clearDisplay(); // Clear the buffer
      bool buttonPressed = digitalRead(button) == LOW;
      if (buttonPressed) {
        while (digitalRead(button) == LOW) {
          Serial.println("heleo");
          myServo.write(0);
          goc = myServo.read();
          Serial.print("Góc hiện tại: "); Serial.println(goc);
          delay(500);
        
          myServo.write(70);
          goc = myServo.read();
          Serial.print("Góc hiện tại: "); Serial.println(goc);
          delay(500);
  }
  }
  else {
    
}
      // Display the appropriate bitmap based on the flag
      if (displayFirstImage) {
       display.drawBitmap(0, 0, image_data_2array, 128, 64, 1);
        display.display();
        delay(5000); // Pause for 1.5 seconds
        display.clearDisplay();  // Clear the buffer
        display.drawBitmap(0, 0, image_data_3array, 128, 64, 1);
        display.display();
        delay(5000); // Pause for 1.5 seconds
        display.clearDisplay();  // Clear the buffer
        display.drawBitmap(0, 0,image_data_openarray, 128, 64, 1);
        display.display();
        delay(1000); // Pause for 1.5 seconds
       
    }
    if (millis() != 0){
      millis() == 0;
    }
      display.display();
    }
    delay(50); // Debouncing delay
  
  }

  // Button is not pressed, clear the display
  else{
    myServo.write(35);
    goc = myServo.read();
    Serial.print("Góc hiện tại: "); Serial.println(goc);
    delay(100);
  delay(50); // Pause for half second
  display.clearDisplay();  // Clear the buffer

// Displays SECONDarray on the screen
  display.drawBitmap(0, 0, image_data_3array, 128, 64, 1);
  display.display();

  delay(5000); // Pause for 1.5 seconds
  display.clearDisplay();  // Clear the buffer

// Displays THIRDarray on the screen
  display.drawBitmap(0, 0, image_data_openarray, 128, 64, 1); 
  display.display();
  delay(200);
}

  // Reset the flag to display the first image the next time the button is pressed
  displayFirstImage = true;

}































